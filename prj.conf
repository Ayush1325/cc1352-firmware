## CMakeLists.txt
```
# SPDX-License-Identifier: Apache-2.0

cmake_minimum_required(VERSION 3.20.0)

include_directories(".")

find_package(Zephyr REQUIRED HINTS $ENV{ZEPHYR_BASE})
project(cc1352_firmware)

target_sources(app PRIVATE src/main.c)

add_subdirectory(mdns)
```

## Kconfig
```
mainmenu "CC1352 GREYBUS Host Application"

config BEAGLEPLAY_HDLC_MAX_BLOCK_SIZE
  int "Maximum hdlc block size supported"
  default 140

config BEAGLEPLAY_GREYBUS_MDNS_DISCOVERY
	bool "Enable mdns based node discovery"
	default y

config BEAGLEPLAY_GREYBUS_STATIC_NODES_ENABLE
	bool "Enable nodes with static IP address"
	help
	  Allows specifying nodes whose address is known in advance.

if BEAGLEPLAY_GREYBUS_STATIC_NODES_ENABLE

config BEAGLEPLAY_GREYBUS_STATIC_NODES
	string "Comma seperated list of nodes"
	help
	  Allow specifying a list of nodes statically.

endif

module = BEAGLEPLAY_GREYBUS
module-str = beagleplay_greybus
source "subsys/logging/Kconfig.template.log_config"

source "Kconfig.zephyr"
```

## west.yml
```
# Copyright (c) 2024 Ayush Singh <ayush@beagleboard.org>
# SPDX-License-Identifier: Apache-2.0

manifest:
  self:
    west-commands: scripts/west-commands.yml

  remotes:
    - name: zephyrproject-rtos
      url-base: https://github.com/zephyrproject-rtos

  projects:
    - name: zephyr
      remote: zephyrproject-rtos
      revision: main
      import:
        name-allowlist:
          - hal_ti
          - cmsis_6

    - name: greybus
      url: https://github.com/Ayush1325/greybus-for-zephyr.git
      revision: main
      path: modules/lib/greybus
```

## prj.conf
```kconfig
# UART
CONFIG_SERIAL=y
CONFIG_UART_INTERRUPT_DRIVEN=y

# Logging
CONFIG_LOG=y
CONFIG_LOG_OUTPUT=y
# CONFIG_BEAGLEPLAY_GREYBUS_LOG_LEVEL_DBG=y

# Networking
CONFIG_NETWORKING=y
CONFIG_NET_UDP=y
CONFIG_NET_TCP=y
CONFIG_NET_IPV4=n
CONFIG_NET_IPV6=y

# Generic networking options
CONFIG_NET_SOCKETS=y
CONFIG_NET_SOCKETS_POLL_MAX=32
CONFIG_NET_CONNECTION_MANAGER=y
CONFIG_HEAP_MEM_POOL_SIZE=1024
CONFIG_NET_SOCKETPAIR=y
CONFIG_NET_TCP_RETRY_COUNT=4
CONFIG_NET_TCP_INIT_RETRANSMISSION_TIMEOUT=1000
# TODO: Use keepalive once switch to upstream zephyr
# CONFIG_NET_TCP_KEEPALIVE=y
# CONFIG_NET_TCP_KEEPIDLE_DEFAULT=1
# CONFIG_NET_TCP_KEEPINTVL_DEFAULT=1
# CONFIG_NET_TCP_KEEPCNT_DEFAULT=2

# Network Config
CONFIG_NET_CONFIG_SETTINGS=y
CONFIG_NET_CONFIG_AUTO_INIT=y
CONFIG_NET_CONFIG_NEED_IPV6=y
CONFIG_NET_CONFIG_NEED_IPV4=n
CONFIG_NET_CONFIG_MY_IPV6_ADDR="2001:db8::2"
CONFIG_NET_CONFIG_PEER_IPV6_ADDR="2001:db8::1"

# Config options that probably should go into Kconfig.defconf
CONFIG_NET_L2_IEEE802154=y
CONFIG_NET_CONFIG_IEEE802154_CHANNEL=1
CONFIG_IEEE802154_CC13XX_CC26XX_SUB_GHZ_NUM_RX_BUF=8
CONFIG_NET_CONFIG_IEEE802154_RADIO_TX_POWER=20
CONFIG_IEEE802154_CC13XX_CC26XX_SUB_GHZ_CS_THRESHOLD=-20
CONFIG_NET_CONFIG_IEEE802154_PAN_ID=0xabcd
CONFIG_IEEE802154_CC13XX_CC26XX=n
CONFIG_NET_DEFAULT_IF_IEEE802154=y

# Kernel options
CONFIG_ENTROPY_GENERATOR=y
CONFIG_TEST_RANDOM_GENERATOR=y

# Network buffers
CONFIG_NET_PKT_RX_COUNT=32
CONFIG_NET_PKT_TX_COUNT=32
CONFIG_NET_BUF_RX_COUNT=32
CONFIG_NET_BUF_TX_COUNT=32
CONFIG_NET_CONTEXT_NET_PKT_POOL=y
CONFIG_NET_L2_IEEE802154_FRAGMENT_REASS_CACHE_SIZE=8

# IP address options
CONFIG_NET_IF_UNICAST_IPV6_ADDR_COUNT=3
CONFIG_NET_IF_MCAST_IPV6_ADDR_COUNT=5
CONFIG_NET_MAX_CONTEXTS=10

# MISC
CONFIG_RING_BUFFER=y

# Application Config
CONFIG_BEAGLEPLAY_HDLC_MAX_BLOCK_SIZE=256
CONFIG_CRC=y
CONFIG_BEAGLEPLAY_GREYBUS_MDNS_DISCOVERY=y
# CONFIG_BEAGLEPLAY_GREYBUS_STATIC_NODES_ENABLE=y
# CONFIG_BEAGLEPLAY_GREYBUS_STATIC_NODES="2001:db8::1"

# mDNS Discovery
CONFIG_ZVFS_POLL_MAX=5
CONFIG_DNS_RESOLVER=y
CONFIG_MDNS_RESOLVER=y
CONFIG_DNS_SERVER_IP_ADDRESSES=y

CONFIG_GREYBUS=y
CONFIG_GREYBUS_NODE=n
CONFIG_GREYBUS_APBRIDGE=y
CONFIG_GREYBUS_SVC=y

CONFIG_MAIN_STACK_SIZE=2048
CONFIG_SYSTEM_WORKQUEUE_STACK_SIZE=2048
```

## src/main.c
```c
// SPDX-License-Identifier: Apache-2.0
/*
 * Copyright (c) 2023 Ayush Singh <ayushdevel1325@gmail.com>
 */

#include "ap.h"
#include <greybus/greybus_protocols.h>
#include "hdlc.h"
#include "node.h"
#include "tcp_discovery.h"
#include <zephyr/drivers/uart.h>
#include <zephyr/init.h>
#include <zephyr/kernel.h>
#include <zephyr/logging/log.h>
#include <zephyr/net/net_ip.h>
#include <greybus/svc.h>

#define UART_DEVICE_NODE  DT_CHOSEN(zephyr_shell_uart)
#define CONTROL_SVC_START 0x01
#define CONTROL_SVC_STOP  0x02

LOG_MODULE_REGISTER(cc1352_greybus, CONFIG_BEAGLEPLAY_GREYBUS_LOG_LEVEL);

static const struct device *const uart_dev = DEVICE_DT_GET(UART_DEVICE_NODE);

/**
 * struct hdlc_greybus_frame - Structure to represent greybus HDLC frame
 *
 * @cport: cport id
 * @hdr: greybus operation header
 * @payload: greybus message payload
 */
struct hdlc_greybus_frame {
	uint16_t cport;
	struct gb_operation_msg_hdr hdr;
	uint8_t payload[];
} __packed;

static int hdlc_send_callback(const uint8_t *buffer, size_t buffer_len)
{
	size_t i;

	for (i = 0; i < buffer_len; ++i) {
		uart_poll_out(uart_dev, buffer[i]);
	}

	return i;
}

static void serial_callback(const struct device *dev, void *user_data)
{
	ARG_UNUSED(user_data);

	uint8_t *buf;
	int ret;

	if (!uart_irq_update(dev) && !uart_irq_rx_ready(dev)) {
		return;
	}

	ret = hdlc_rx_start(&buf);
	if (ret == 0) {
		/* No space */
		LOG_ERR("No more space for HDLC receive");
		return;
	}

	ret = uart_fifo_read(dev, buf, ret);
	if (ret < 0) {
		/* Something went wrong */
		LOG_ERR("Failed to read UART");
		return;
	}

	ret = hdlc_rx_finish(ret);
	if (ret < 0) {
		/* Some error */
		LOG_ERR("Filed to write data to hdlc buffer");
		return;
	}
}

static int hdlc_process_greybus_frame(const char *buffer, size_t buffer_len)
{
	struct gb_message *msg;
	int ret;
	struct hdlc_greybus_frame *gb_frame = (struct hdlc_greybus_frame *)buffer;
	size_t msg_len = buffer_len - sizeof(uint16_t);
	struct gb_operation_msg_hdr *hdr = (struct gb_operation_msg_hdr *)&buffer[sizeof(uint16_t)];

	if (sys_le16_to_cpu(gb_frame->hdr.size) > msg_len) {
		LOG_ERR("Greybus Message size is greater than received buffer.");
		return -1;
	}

	msg = gb_message_alloc(gb_hdr_payload_len(hdr), gb_frame->hdr.type,
			       gb_frame->hdr.operation_id, gb_frame->hdr.result);
	if (!msg) {
		LOG_ERR("Failed to allocate greybus message");
		return -1;
	}

	memcpy(msg->payload, gb_frame->payload, gb_message_payload_len(msg));
	ret = ap_rx_submit(msg, sys_le16_to_cpu(gb_frame->cport));
	if (ret < 0) {
		LOG_ERR("Failed add message to AP Queue");
		return ret;
	}

	return 0;
}

static int control_process_frame(const char *buffer, size_t buffer_len)
{
	uint8_t command;

	if (buffer_len != 1) {
		LOG_ERR("Invalid Buffer");
		return -1;
	}

	command = buffer[0];

	switch (command) {
	case CONTROL_SVC_START: {
		LOG_INF("Starting SVC");
		ap_init();
		gb_apbridge_init();
		gb_svc_init();
		node_rx_start();
		tcp_discovery_start();
		return 0;
	}
	case CONTROL_SVC_STOP:
		LOG_INF("Stopping SVC");
		tcp_discovery_stop();
		node_destroy_all();
		gb_svc_deinit();
		ap_deinit();
		gb_apbridge_deinit();
		return 0;
	}

	return -1;
}

static int hdlc_process_complete_frame(const void *buffer, size_t len, uint8_t address)
{
	switch (address) {
	case ADDRESS_GREYBUS:
		return hdlc_process_greybus_frame(buffer, len);
	case ADDRESS_CONTROL:
		return control_process_frame(buffer, len);
	case ADDRESS_DBG:
		LOG_WRN("Ignore DBG Frame");
		return 0;
	}

	return -1;
}

int main(void)
{
	int ret;

	LOG_INF("Starting BeaglePlay Greybus");
	tcp_discovery_stop();

	if (!device_is_ready(uart_dev)) {
		LOG_ERR("UART device not found!");
		return -ENODEV;
	}

	hdlc_init(hdlc_process_complete_frame, hdlc_send_callback);

	ret = uart_irq_callback_user_data_set(uart_dev, serial_callback, NULL);
	if (ret < 0) {
		if (ret == -ENOTSUP) {
			LOG_ERR("Interrupt-driven UART API support not enabled\n");
		} else if (ret == -ENOSYS) {
			LOG_ERR("UART device does not support interrupt-driven API\n");
		} else {
			LOG_ERR("Error setting UART callback: %d\n", ret);
		}
		return ret;
	}

	uart_irq_rx_enable(uart_dev);

	k_sleep(K_FOREVER);

	return 0;
}
```

## include/ap.h
```c
/* SPDX-License-Identifier: Apache-2.0 */
/*
 * Copyright (c) 2023 Ayush Singh <ayushdevel1325@gmail.com>
 */

#ifndef _AP_H_
#define _AP_H_

#include <greybus/apbridge.h>

#define AP_INF_ID       1
#define AP_SVC_CPORT_ID 0

/*
 * Initialize AP interface
 *
 * @return AP Interface
 */
void ap_init(void);

/*
 * De-Initialize AP Interface
 *
 * Note: This should be called only after all connections have been closed. This does not take care
 * of closing connections or flushing pending data.
 */
void ap_deinit(void);

/*
 * Submit message received by AP from transport
 *
 * @param greybus message
 * @param cport_id
 *
 * @return 0 if successful, negative in case of error
 */
static inline int ap_rx_submit(struct gb_message *msg, uint16_t cport_id)
{
	return gb_apbridge_send(AP_INF_ID, cport_id, msg);
}

#endif
```

## include/apbridge.h
```c
/* SPDX-License-Identifier: Apache-2.0 */
/*
 * Copyright (c) 2023 Ayush Singh <ayushdevel1325@gmail.com>
 */

#ifndef _APBRIDGE_H_
#define _APBRIDGE_H_

#include <stdint.h>
#include <greybus/greybus_messages.h>

void apbridge_init(void);

void apbridge_deinit(void);

int connection_create(uint8_t intf1_id, uint16_t intf1_cport, uint8_t intf2_id,
		      uint16_t intf2_cport);

int connection_destroy(uint8_t intf1_id, uint16_t intf1_cport, uint8_t intf2_id,
		       uint16_t intf2_cport);

int connection_send(uint8_t intf_id, uint16_t intf_cport, struct gb_message *msg);

/*
 * Send a message to the node
 *
 * @msg: The message to send
 * @cport: The cport of ap
 *
 * Returns 0 on success, negative errno on failure
 */
// int node_to_ap(struct gb_message *msg, uint16_t cport);

/*
 * Send a message to the AP
 *
 * @msg: The message to send
 * @cport: The cport of ap
 *
 * Returns 0 on success, negative errno on failure
 */
// int ap_to_node(struct gb_message *msg, uint16_t cport);

// int ap_register_node(uint16_t cport, node_send_fn fn, void *priv);

// int ap_derigster_node(uint16_t cport);

#endif
```

## include/greybus_interfaces.h
```c
/* SPDX-License-Identifier: Apache-2.0 */
/*
 * Copyright (c) 2023 Ayush Singh <ayushdevel1325@gmail.com>
 */

#ifndef _OPERATIONS_H_
#define _OPERATIONS_H_

#include <zephyr/sys/dlist.h>
#include <zephyr/types.h>
#include <greybus/greybus_messages.h>

struct gb_interface;

/*
 * Callback for writing to an interface
 *
 * @param controller
 * @param greybus message to send
 * @param Cport to write to
 *
 * @return 0 if successful. Negative in case of error
 */
typedef int (*gb_controller_write_callback_t)(struct gb_interface *, struct gb_message *, uint16_t);

/*
 * Callback to create new connection with a Cport in the interface
 *
 * @param controller
 * @param cport
 *
 * @return 0 if successful. Negative in case of error
 */
typedef int (*gb_controller_create_connection_t)(struct gb_interface *, uint16_t);

/*
 * Callback to destroy connection with a Cport in the interface
 *
 * @param controller
 * @param cport
 */
typedef void (*gb_controller_destroy_connection_t)(struct gb_interface *, uint16_t);

/*
 * A greybus interface. Can have multiple Cports
 *
 * @param id: Interface ID
 * @param write: a non-blocking write function. The ownership of message is
 * transferred.
 * @param ctrl_data: private controller data
 */
struct gb_interface {
	uint8_t id;
	gb_controller_write_callback_t write;
	gb_controller_create_connection_t create_connection;
	gb_controller_destroy_connection_t destroy_connection;
	void *ctrl_data;
};

/*
 * Allocate a greybus interface
 *
 * @param read callback
 * @param write callback
 * @param create connection callback
 * @param destroy connection callback
 * @param controller data
 *
 * @return allocated greybus interface. NULL in case of error
 */
struct gb_interface *gb_interface_alloc(gb_controller_write_callback_t write_cb,
					gb_controller_create_connection_t create_connection_cb,
					gb_controller_destroy_connection_t destroy_connection_cb,
					void *ctrl_data);

/*
 * Deallocate a greybus interface
 *
 * @param greybus interface
 */
void gb_interface_dealloc(struct gb_interface *intf);

/*
 * Get interface associated with interface id.
 *
 * @param interface id
 *
 * @param greybus interface
 */
struct gb_interface *gb_interface_find_by_id(uint8_t intf_id);

#endif
```

## include/hdlc.h
```c
/* SPDX-License-Identifier: Apache-2.0 */
/*
 * Copyright (c) 2023 Ayush Singh <ayushdevel1325@gmail.com>
 */

#ifndef _HDLC_H_
#define _HDLC_H_

#include <stdint.h>
#include <zephyr/device.h>
#include <greybus/greybus_messages.h>

#define HDLC_MAX_BLOCK_SIZE CONFIG_BEAGLEPLAY_HDLC_MAX_BLOCK_SIZE

#define ADDRESS_GREYBUS 0x01
#define ADDRESS_DBG     0x02
#define ADDRESS_CONTROL 0x03
#define ADDRESS_MCUMGR  0x04

/*
 * Calback to process a received HDLC frame
 *
 * @param payload
 * @param payload len
 * @param HDLC address
 *
 * @return Negative in case of error
 */
typedef int (*hdlc_process_frame_callback)(const void *, size_t, uint8_t);

/*
 * Callback to send HDLC data
 *
 * @param buffer
 * @param buffer length
 *
 * @return Number of bytes sent, negative in case of error
 */
typedef int (*hdlc_send_frame_callback)(const uint8_t *, size_t);

/*
 * Initialize internal HDLC stuff
 *
 * @return 0 if successful. Negative in case of error.
 */
int hdlc_init(hdlc_process_frame_callback process_cb, hdlc_send_frame_callback send_cb);

/*
 * Submit an HDLC Block synchronously
 *
 * @param buffer
 * @param buffer_length
 * @param address
 * @param control
 *
 * @return block size (>= 0) if successful. Negative in case of error
 */
int hdlc_block_send_sync(const uint8_t *buffer, size_t buffer_len, uint8_t address,
			 uint8_t control);

/*
 * Get a buffer to write HDLC message received for processing. Make HDLC transport agnostic.
 *
 * @param the pointer to underlying buffer which can be used to write.
 *
 * @return number of bytes that can be written
 */
uint32_t hdlc_rx_start(uint8_t **buffer);

/*
 * Finish writing to rx buffer. Also queues rx buffer for processing
 *
 * @param number of bytes written
 *
 * @return 0 if successful. Negative in case of error.
 */
int hdlc_rx_finish(uint32_t written);

/*
 * Send a greybus message over HDLC
 *
 * @param Greybus message
 */
static inline int gb_message_hdlc_send(struct gb_message *msg, uint16_t cport)
{
	char buffer[HDLC_MAX_BLOCK_SIZE];

	memcpy(buffer, &sys_cpu_to_le16(cport), sizeof(cport));
	memcpy(&buffer[sizeof(cport)], &msg->header, sizeof(struct gb_operation_msg_hdr));
	memcpy(&buffer[sizeof(struct gb_operation_msg_hdr) + sizeof(cport)], msg->payload,
	       gb_message_payload_len(msg));

	hdlc_block_send_sync(buffer, msg->header.size + sizeof(cport), ADDRESS_GREYBUS, 0x03);

	return 0;
}

#endif
```

## include/node.h
```c
/* SPDX-License-Identifier: Apache-2.0 */
/*
 * Copyright (c) 2023 Ayush Singh <ayushdevel1325@gmail.com>
 */

#ifndef _NODE_H_
#define _NODE_H_

#include <zephyr/net/net_ip.h>
#include <greybus/apbridge.h>

#define GB_TRANSPORT_TCPIP_BASE_PORT 4242

/*
 * Destroy a tcp greybus interface
 *
 * @return greybus interface
 */
void node_destroy_interface(struct gb_interface *intf);

/*
 * Checks if any new nodes have been added or any previous nodes removed.
 *
 * @param list of nodes discovered
 * @param lenght of nodes list
 */
void node_filter(struct in6_addr *active_addr, size_t active_len);

/*
 * Destroy all current node interfaces.
 *
 * Note: This does not destroy the connections
 */
void node_destroy_all(void);

void node_rx_start(void);

#endif
```

## include/svc.h
```c
/* SPDX-License-Identifier: Apache-2.0 */
/*
 * Copyright (c) 2023 Ayush Singh <ayushdevel1325@gmail.com>
 */

#ifndef _SVC_H_
#define _SVC_H_

#include <stdbool.h>
#include <zephyr/types.h>
#include <greybus/apbridge.h>

#define SVC_INF_ID 0

/*
 * Initialize SVC Interface. Should be called before sending any greybus
 * request.
 */
void svc_init(void);

/*
 * Create SVC_TYPE_VERSION greybus message and queue it for sending.
 *
 * @return 0 if successful, else error.
 */
int svc_send_version(void);

/*
 * Send the SVC module inserted request.
 *
 * @param interface id of the new module
 *
 * @return 0 if successfully, negative in case of error
 */
int svc_send_module_inserted(uint8_t intf_id);

/*
 * Send the SVC module removed request.
 *
 * @param interface id of the module removed
 *
 * @return 0 if successfully, negative in case of error
 */
int svc_send_module_removed(struct gb_interface *intf);

/*
 * Get the SVC interface
 *
 * @return pointer to svc interface
 */
struct gb_interface *svc_interface(void);

/*
 * De-Initialize SVC
 */
void svc_deinit(void);

bool svc_is_ready(void);

#endif
```

## src/ap.c
```c
// SPDX-License-Identifier: Apache-2.0
/*
 * Copyright (c) 2023 Ayush Singh <ayushdevel1325@gmail.com>
 */

#include "ap.h"
#include "hdlc.h"
#include <zephyr/kernel.h>
#include <zephyr/logging/log.h>

LOG_MODULE_DECLARE(cc1352_greybus, CONFIG_BEAGLEPLAY_GREYBUS_LOG_LEVEL);

static int ap_send(struct gb_interface *intf, struct gb_message *msg, uint16_t cport) {

	int ret = gb_message_hdlc_send(msg, cport);
	gb_message_dealloc(msg);

	return ret;
}

static struct gb_interface intf = {
	.id = AP_INF_ID,
	.write = ap_send,
};

void ap_init(void)
{
	gb_interface_add(&intf);
}

void ap_deinit(void)
{
	gb_interface_remove(intf.id);
}
```

## src/apbridge.c
```c
#include "apbridge.h"
#include "operations.h"
#include <zephyr/kernel.h>

static void apbridge_entry(void *p1, void *p2, void *p3)
{
	ARG_UNUSED(p1);
	ARG_UNUSED(p2);
	ARG_UNUSED(p3);

	while (1) {
		/* Go through all connections */
		gb_connection_process_all();
		k_yield();
	}
}

K_THREAD_DEFINE(apbridge, 2048, apbridge_entry, NULL, NULL, NULL, 6, 0, 0);

void apbridge_start() {
	k_thread_resume(apbridge);
}

void apbridge_stop() {
	k_thread_suspend(apbridge);
}
```

## src/greybus_interfaces.c
```c
// SPDX-License-Identifier: Apache-2.0
/*
 * Copyright (c) 2023 Ayush Singh <ayushdevel1325@gmail.com>
 */

#include "greybus_interfaces.h"
#include "local_node.h"
#include "node.h"
#include "svc.h"
#include <zephyr/kernel.h>
#include <zephyr/logging/log.h>
#include <zephyr/sys/dlist.h>

#define INTERFACE_ID_START     3
#define MAX_GREYBUS_INTERFACES CONFIG_BEAGLEPLAY_GREYBUS_MAX_INTERFACES

LOG_MODULE_DECLARE(cc1352_greybus, CONFIG_BEAGLEPLAY_GREYBUS_LOG_LEVEL);

K_MEM_SLAB_DEFINE_STATIC(gb_interface_slab, sizeof(struct gb_interface), MAX_GREYBUS_INTERFACES, 4);

static atomic_t interface_id_counter = ATOMIC_INIT(INTERFACE_ID_START);

static uint8_t new_interface_id(void)
{
	atomic_val_t temp = atomic_inc(&interface_id_counter);

	if (temp == UINT8_MAX) {
		atomic_set(&interface_id_counter, INTERFACE_ID_START);
	}
	return temp;
}

struct gb_interface *gb_interface_alloc(gb_controller_write_callback_t write_cb,
					gb_controller_create_connection_t create_connection,
					gb_controller_destroy_connection_t destroy_connection,
					void *ctrl_data)
{
	int ret;
	struct gb_interface *intf;

	ret = k_mem_slab_alloc(&gb_interface_slab, (void **)&intf, K_NO_WAIT);
	if (ret < 0) {
		return NULL;
	}

	intf->id = new_interface_id();
	intf->write = write_cb;
	intf->create_connection = create_connection;
	intf->destroy_connection = destroy_connection;
	intf->ctrl_data = ctrl_data;

	return intf;
}

void gb_interface_dealloc(struct gb_interface *intf)
{
	k_mem_slab_free(&gb_interface_slab, (void **)&intf);
}

struct gb_interface *gb_interface_find_by_id(uint8_t intf_id)
{
	switch (intf_id) {
	case SVC_INF_ID:
		return svc_interface();
	case LOCAL_NODE_ID:
		return local_node_interface();
	default:
		return node_find_by_id(intf_id);
	}
}
```

## src/greybus_messages.c
```c
// SPDX-License-Identifier: Apache-2.0
/*
 * Copyright (c) 2023 Ayush Singh <ayushdevel1325@gmail.com>
 */

#include <greybus/greybus_messages.h>
#include <zephyr/kernel.h>
#include <zephyr/logging/log.h>

#define OPERATION_ID_START 1

LOG_MODULE_DECLARE(cc1352_greybus, CONFIG_BEAGLEPLAY_GREYBUS_LOG_LEVEL);
K_HEAP_DEFINE(greybus_messages_heap, CONFIG_BEAGLEPLAY_GREYBUS_MESSAGES_HEAP_MEM_POOL_SIZE);

static atomic_t operation_id_counter = ATOMIC_INIT(OPERATION_ID_START);

uint16_t new_operation_id(void)
{
	atomic_val_t temp = atomic_inc(&operation_id_counter);

	if (temp == UINT16_MAX) {
		atomic_set(&operation_id_counter, OPERATION_ID_START);
	}
	return temp;
}

struct gb_message *gb_message_alloc(size_t payload_len, uint8_t message_type, uint16_t operation_id,
				    uint8_t status)
{
	struct gb_message *msg;

	msg = k_heap_alloc(&greybus_messages_heap, sizeof(struct gb_message) + payload_len,
			   K_NO_WAIT);
	if (msg == NULL) {
		LOG_WRN("Failed to allocate Greybus request message");
		return NULL;
	}

	msg->header.size = sizeof(struct gb_operation_msg_hdr) + payload_len;
	msg->header.operation_id = operation_id;
	msg->header.type = message_type;
	msg->header.result = status;

	return msg;
}

void gb_message_dealloc(struct gb_message *msg)
{
	k_heap_free(&greybus_messages_heap, msg);
}

struct gb_message *gb_message_request_alloc(size_t payload_len, uint8_t request_type,
					    bool is_oneshot)
{
	uint16_t operation_id = is_oneshot ? 0 : new_operation_id();

	struct gb_message *msg = gb_message_alloc(payload_len, request_type, operation_id, 0);

	return msg;
}
```

## src/hdlc.c
```c
// SPDX-License-Identifier: Apache-2.0
/*
 * Copyright (c) 2016-2019 Intel Corporation
 * Copyright (c) 2020 Statropy Software LLC
 *
 * Modifications Copyright (c) 2023 Ayush Singh <ayushdevel1325@gmail.com>
 */

#include "hdlc.h"
#include <string.h>
#include <zephyr/drivers/uart.h>
#include <zephyr/kernel.h>
#include <zephyr/logging/log.h>
#include <zephyr/sys/crc.h>
#include <zephyr/sys/ring_buffer.h>
#include <greybus/greybus_protocols.h>

#define HDLC_RX_BUF_SIZE 1024

#define HDLC_FRAME     0x7E
#define HDLC_ESC       0x7D
#define HDLC_ESC_FRAME 0x5E
#define HDLC_ESC_ESC   0x5D

#define HDLC_RX_WORKQUEUE_STACK_SIZE 2048
#define HDLC_RX_WORKQUEUE_PRIORITY   5

static void hdlc_rx_handler(struct k_work *);

LOG_MODULE_DECLARE(cc1352_greybus, CONFIG_BEAGLEPLAY_GREYBUS_LOG_LEVEL);

K_WORK_DEFINE(hdlc_rx_work, hdlc_rx_handler);
RING_BUF_DECLARE(hdlc_rx_ringbuf, HDLC_RX_BUF_SIZE);

struct hdlc_driver {
	hdlc_process_frame_callback process_callback_frame_cb;
	hdlc_send_frame_callback send_frame_cb;

	uint16_t crc;
	bool next_escaped;
	uint8_t rx_send_seq;
	uint8_t send_seq;
	uint16_t rx_buffer_len;
	uint8_t rx_buffer[HDLC_MAX_BLOCK_SIZE];
};

static struct hdlc_driver hdlc_driver;

static void uart_poll_out_crc(uint8_t byte, uint16_t *crc)
{
	uint8_t temp;

	*crc = crc16_ccitt(*crc, &byte, 1);
	if (byte == HDLC_FRAME || byte == HDLC_ESC) {
		temp = HDLC_ESC;
		hdlc_driver.send_frame_cb(&temp, 1);
		byte ^= 0x20;
	}
	hdlc_driver.send_frame_cb(&byte, 1);
}

static void hdlc_process_complete_frame(struct hdlc_driver *drv)
{
	int ret;
	uint8_t address = drv->rx_buffer[0];
	size_t len = drv->rx_buffer_len - 4;
	void *buffer = &drv->rx_buffer[2];

	ret = drv->process_callback_frame_cb(buffer, len, address);

	if (ret < 0) {
		LOG_ERR("Dropped HDLC addr:%x ctrl:%x", address, drv->rx_buffer[1]);
		LOG_HEXDUMP_DBG(drv->rx_buffer, drv->rx_buffer_len, "rx_buffer");
	}
}

static void hdlc_process_frame(struct hdlc_driver *drv)
{
	if (drv->rx_buffer_len > 3 && drv->crc == 0xf0b8) {
		uint8_t ctrl = drv->rx_buffer[1];

		if ((ctrl & 1) == 0) {
			drv->rx_send_seq = (ctrl >> 5) & 0x07;
		} else {
			hdlc_process_complete_frame(drv);
		}
	} else {
		LOG_ERR("Dropped HDLC crc:%04x len:%d", drv->crc, drv->rx_buffer_len);
	}

	drv->crc = 0xffff;
	drv->rx_buffer_len = 0;
}

static int hdlc_save_byte(struct hdlc_driver *drv, uint8_t byte)
{
	if (drv->rx_buffer_len >= HDLC_MAX_BLOCK_SIZE) {
		LOG_ERR("HDLC RX Buffer Overflow");
		drv->crc = 0xffff;
		drv->rx_buffer_len = 0;
	}

	drv->rx_buffer[drv->rx_buffer_len++] = byte;

	return 0;
}

static void hdlc_rx_input_byte(struct hdlc_driver *drv, uint8_t byte)
{
	switch (byte) {
	case HDLC_FRAME:
		if (drv->rx_buffer_len) {
			hdlc_process_frame(drv);
		}
		break;
	case HDLC_ESC:
		drv->next_escaped = true;
		break;
	default:
		if (drv->next_escaped) {
			byte ^= 0x20;
			drv->next_escaped = false;
		}
		drv->crc = crc16_ccitt(drv->crc, &byte, 1);
		hdlc_save_byte(drv, byte);
	}
}

static int hdlc_process_buffer(uint8_t *buf, size_t len)
{
	for (size_t i = 0; i < len; ++i) {
		hdlc_rx_input_byte(&hdlc_driver, buf[i]);
	}
	return len;
}

static void hdlc_rx_handler(struct k_work *work)
{
	ARG_UNUSED(work);

	uint8_t *data;
	int ret;

	ret = ring_buf_get_claim(&hdlc_rx_ringbuf, &data, HDLC_RX_BUF_SIZE);
	ret = hdlc_process_buffer(data, ret);
	if (ret < 0) {
		LOG_ERR("Error processing HDLC buffer");
	}

	ret = ring_buf_get_finish(&hdlc_rx_ringbuf, ret);
	if (ret < 0) {
		LOG_ERR("Cannot flush ring buffer (%d)", ret);
	}
}

int hdlc_block_send_sync(const uint8_t *buffer, size_t buffer_len, uint8_t address, uint8_t control)
{
	uint8_t temp = HDLC_FRAME;
	uint16_t crc = 0xffff;

	hdlc_driver.send_frame_cb(&temp, 1);
	uart_poll_out_crc(address, &crc);

	if (control == 0) {
		uart_poll_out_crc(hdlc_driver.send_seq << 1, &crc);
	} else {
		uart_poll_out_crc(control, &crc);
	}

	for (int i = 0; i < buffer_len; i++) {
		uart_poll_out_crc(buffer[i], &crc);
	}

	uint16_t crc_calc = crc ^ 0xffff;

	uart_poll_out_crc(crc_calc, &crc);
	uart_poll_out_crc(crc_calc >> 8, &crc);
	hdlc_driver.send_frame_cb(&temp, 1);

	return 0;
}

int hdlc_init(hdlc_process_frame_callback process_cb, hdlc_send_frame_callback send_cb)
{
	hdlc_driver.crc = 0xffff;
	hdlc_driver.send_seq = 0;
	hdlc_driver.rx_send_seq = 0;
	hdlc_driver.next_escaped = false;
	hdlc_driver.rx_buffer_len = 0;

	hdlc_driver.process_callback_frame_cb = process_cb;
	hdlc_driver.send_frame_cb = send_cb;

	return 0;
}

uint32_t hdlc_rx_start(uint8_t **buf)
{
	return ring_buf_put_claim(&hdlc_rx_ringbuf, buf, HDLC_RX_BUF_SIZE);
}

int hdlc_rx_finish(uint32_t written)
{
	int ret;

	ret = ring_buf_put_finish(&hdlc_rx_ringbuf, written);
	k_work_submit(&hdlc_rx_work);

	return ret;
}
```

## src/local_node.c
```c
// SPDX-License-Identifier: Apache-2.0
/*
 * Copyright (c) 2016 Alexandre Bailon
 *
 * Modifications Copyright (c) 2023 Ayush Singh <ayushdevel1325@gmail.com>
 */

#include "greybus_interfaces.h"
#include "local_node.h"
#include <zephyr/kernel.h>
#include <zephyr/logging/log.h>
#include "apbridge.h"

#define CPORTS_NUM 1

#define CONTROL_PROTOCOL_CPORT 0

LOG_MODULE_DECLARE(cc1352_greybus, CONFIG_BEAGLEPLAY_GREYBUS_LOG_LEVEL);

static const uint8_t manifest[] = {
	0x3c, 0x00, 0x00, 0x01, 0x08, 0x00, 0x01, 0x00, 0x01, 0x02, 0x00, 0x00, 0x18, 0x00, 0x02,
	0x00, 0x11, 0x01, 0x42, 0x65, 0x61, 0x67, 0x6c, 0x65, 0x50, 0x6c, 0x61, 0x79, 0x20, 0x43,
	0x43, 0x31, 0x33, 0x35, 0x32, 0x00, 0x18, 0x00, 0x02, 0x00, 0x11, 0x02, 0x42, 0x65, 0x61,
	0x67, 0x6c, 0x65, 0x50, 0x6c, 0x61, 0x79, 0x20, 0x43, 0x43, 0x31, 0x33, 0x35, 0x32, 0x00};

static void response_helper(struct gb_interface *ctrl, struct gb_message *msg, const void *payload,
			    size_t payload_len, uint8_t status, uint16_t cport_id)
{
	int ret;
	struct gb_message *resp = gb_message_response_alloc(payload, payload_len, msg->header.type,
							    msg->header.operation_id, status);

	if (resp == NULL) {
		LOG_ERR("Failed to allocate response for %X", msg->header.type);
		return;
	}
	ret = connection_send(LOCAL_NODE_ID, cport_id, resp);
	if (ret < 0) {
		LOG_ERR("Failed to send response for %X", msg->header.type);
	}
}

static void control_protocol_cport_shutdown_handler(struct gb_interface *ctrl,
						    struct gb_message *msg)
{
	response_helper(ctrl, msg, NULL, 0, 0, CONTROL_PROTOCOL_CPORT);
}

static void control_protocol_version_handler(struct gb_interface *ctrl, struct gb_message *msg)
{
	struct gb_control_version_response response = {
		.major = 0,
		.minor = 1,
	};

	response_helper(ctrl, msg, &response, sizeof(response), 0, CONTROL_PROTOCOL_CPORT);
}

static void control_protocol_get_manifest_size_handler(struct gb_interface *ctrl,
						       struct gb_message *msg)
{
	struct gb_control_get_manifest_size_response response = {
		.size = sys_cpu_to_le16(sizeof(manifest)),
	};

	response_helper(ctrl, msg, &response, sizeof(response), 0, CONTROL_PROTOCOL_CPORT);
}

static void control_protocol_get_manifest_handler(struct gb_interface *ctrl, struct gb_message *msg)
{
	response_helper(ctrl, msg, manifest, sizeof(manifest), 0, CONTROL_PROTOCOL_CPORT);
}

static void control_protocol_empty_handler(struct gb_interface *ctrl, struct gb_message *msg)
{
	response_helper(ctrl, msg, NULL, 0, 0, CONTROL_PROTOCOL_CPORT);
}

static void control_protocol_handle(struct gb_interface *ctrl, struct gb_message *msg)
{

	switch (gb_message_type(msg)) {
	case GB_REQUEST_TYPE_CPORT_SHUTDOWN:
		control_protocol_cport_shutdown_handler(ctrl, msg);
		break;
	case GB_CONTROL_TYPE_VERSION:
		control_protocol_version_handler(ctrl, msg);
		break;
	case GB_CONTROL_TYPE_GET_MANIFEST_SIZE:
		control_protocol_get_manifest_size_handler(ctrl, msg);
		break;
	case GB_CONTROL_TYPE_GET_MANIFEST:
		control_protocol_get_manifest_handler(ctrl, msg);
		break;
	case GB_CONTROL_TYPE_CONNECTED:
	case GB_CONTROL_TYPE_DISCONNECTING:
	case GB_CONTROL_TYPE_DISCONNECTED:
	case GB_CONTROL_TYPE_TIMESYNC_ENABLE:
	case GB_CONTROL_TYPE_TIMESYNC_DISABLE:
	case GB_CONTROL_TYPE_TIMESYNC_AUTHORITATIVE:
	case GB_CONTROL_TYPE_INTF_HIBERNATE_ABORT:
		control_protocol_empty_handler(ctrl, msg);
		break;
	default:
		LOG_ERR("Unimplemented control protocol request %X", gb_message_type(msg));
	}
}

static int intf_write(struct gb_interface *ctrl, struct gb_message *msg, uint16_t cport_id)
{
	LOG_DBG("Local node received %u of type %X on cport %u", msg->header.operation_id,
		gb_message_type(msg), cport_id);

	switch (cport_id) {
	case CONTROL_PROTOCOL_CPORT:
		control_protocol_handle(ctrl, msg);
		break;
	}

	gb_message_dealloc(msg);

	return 0;
}

static int intf_create_connection(struct gb_interface *ctrl, uint16_t cport_id)
{
	return 0;
}

static void intf_destroy_connection(struct gb_interface *ctrl, uint16_t cport_id)
{
}

static struct gb_interface intf = {.id = LOCAL_NODE_ID,
				   .write = intf_write,
				   .create_connection = intf_create_connection,
				   .destroy_connection = intf_destroy_connection,
				   .ctrl_data = NULL};

struct gb_interface *local_node_interface(void)
{
	return &intf;
}
```
